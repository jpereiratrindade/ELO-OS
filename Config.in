## Config.in
```kconfig
menu "ELO/OS options"
  source "$BR2_EXTERNAL_ELO_OS_PATH/package/elo-client/Config.in"
endmenu
```

## configs/elo_pi5_client_vision_defconfig
```kconfig
# ELO/OS 0.1.0 - based on Buildroot 2026.08.1 configs/raspberrypi5_defconfig
# Upstream preserved; ELO additions marked below.
BR2_aarch64=y
BR2_cortex_a76=y
BR2_TOOLCHAIN_EXTERNAL=y
BR2_TOOLCHAIN_EXTERNAL_BOOTLIN=y
BR2_TOOLCHAIN_EXTERNAL_BOOTLIN_AARCH64_GLIBC_STABLE=y
BR2_GLOBAL_PATCH_DIR="board/raspberrypi/patches"
BR2_DOWNLOAD_FORCE_CHECK_HASHES=y
BR2_SYSTEM_DHCP="eth0"
BR2_ROOTFS_POST_BUILD_SCRIPT="board/raspberrypi5/post-build.sh $(BR2_EXTERNAL_ELO_OS_PATH)/board/elo/pi5-client/post-build.sh"
BR2_ROOTFS_POST_IMAGE_SCRIPT="board/raspberrypi5/post-image.sh"
BR2_LINUX_KERNEL=y
BR2_LINUX_KERNEL_CUSTOM_TARBALL=y
BR2_LINUX_KERNEL_CUSTOM_TARBALL_LOCATION="$(call github,raspberrypi,linux,21b410140c47ffab5668399f6f143c7d7b935c8b)/linux-21b410140c47ffab5668399f6f143c7d7b935c8b.tar.gz"
BR2_LINUX_KERNEL_DEFCONFIG="bcm2712"
BR2_LINUX_KERNEL_CONFIG_FRAGMENT_FILES="board/raspberrypi/linux-4k-page-size.fragment"
BR2_LINUX_KERNEL_DTS_SUPPORT=y
BR2_LINUX_KERNEL_INTREE_DTS_NAME="broadcom/bcm2712-rpi-5-b broadcom/bcm2712d0-rpi-5-b broadcom/bcm2712-rpi-500"
BR2_LINUX_KERNEL_NEEDS_HOST_OPENSSL=y
BR2_PACKAGE_BUSYBOX_SHOW_OTHERS=y
BR2_PACKAGE_XZ=y
BR2_PACKAGE_RPI_FIRMWARE=y
BR2_PACKAGE_RPI_FIRMWARE_CONFIG_FILE="$(BR2_EXTERNAL_ELO_OS_PATH)/board/elo/pi5-client/config.txt"
BR2_PACKAGE_RPI_FIRMWARE_CMDLINE_FILE="$(BR2_EXTERNAL_ELO_OS_PATH)/board/elo/pi5-client/cmdline.txt"
BR2_PACKAGE_RPI_FIRMWARE_INSTALL_DTB_OVERLAYS=y
BR2_PACKAGE_KMOD=y
BR2_PACKAGE_KMOD_TOOLS=y
BR2_TARGET_ROOTFS_EXT2=y
BR2_TARGET_ROOTFS_EXT2_4=y
BR2_TARGET_ROOTFS_EXT2_SIZE="512M"
# BR2_TARGET_ROOTFS_TAR is not set
BR2_PACKAGE_HOST_DOSFSTOOLS=y
BR2_PACKAGE_HOST_GENIMAGE=y
BR2_PACKAGE_HOST_KMOD_XZ=y
BR2_PACKAGE_HOST_MTOOLS=y

# Experimental Pi 5 CPU-rendered client; provisioned terminals autostart with Wi-Fi.
BR2_TARGET_GENERIC_HOSTNAME="elo-os"
BR2_ROOTFS_OVERLAY="$(BR2_EXTERNAL_ELO_OS_PATH)/board/elo/common/rootfs-overlay $(BR2_EXTERNAL_ELO_OS_PATH)/board/elo/pi5-client/rootfs-overlay"

# Software Qt Quick on the firmware framebuffer; no VC4 or DRM dependency.
BR2_PACKAGE_QT6=y
BR2_PACKAGE_QT6BASE_GUI=y
BR2_PACKAGE_QT6BASE_LINUXFB=y
BR2_PACKAGE_QT6BASE_DEFAULT_QPA="linuxfb"
BR2_PACKAGE_QT6DECLARATIVE=y
BR2_PACKAGE_QT6DECLARATIVE_QUICK=y
BR2_PACKAGE_DEJAVU=y
# BR2_PACKAGE_DEJAVU_MONO is not set
# BR2_PACKAGE_DEJAVU_SERIF is not set
# BR2_PACKAGE_DEJAVU_SANS_CONDENSED is not set
# BR2_PACKAGE_DEJAVU_SERIF_CONDENSED is not set
BR2_PACKAGE_ELO_CLIENT=y
BR2_PACKAGE_OPENCV4=y
BR2_PACKAGE_OPENCV4_LIB_DNN=y
BR2_PACKAGE_OPENCV4_LIB_IMGPROC=y
BR2_PACKAGE_OPENCV4_LIB_OBJDETECT=y
BR2_PACKAGE_OPENCV4_LIB_VIDEOIO=y
BR2_PACKAGE_OPENCV4_WITH_V4L=y
BR2_PACKAGE_ELO_CLIENT_VISION=y
BR2_PACKAGE_BRCMFMAC_SDIO_FIRMWARE_RPI=y
BR2_PACKAGE_BRCMFMAC_SDIO_FIRMWARE_RPI_WIFI=y
BR2_PACKAGE_WIRELESS_REGDB=y
BR2_PACKAGE_IW=y
BR2_PACKAGE_WPA_SUPPLICANT=y
BR2_PACKAGE_WPA_SUPPLICANT_NL80211=y
BR2_PACKAGE_WPA_SUPPLICANT_CTRL_IFACE=y
BR2_PACKAGE_WPA_SUPPLICANT_CLI=y
BR2_PACKAGE_WPA_SUPPLICANT_PASSPHRASE=y

# Remote maintenance and persistent network time; presentation never waits for either.
BR2_PACKAGE_DROPBEAR=y
# BR2_PACKAGE_DROPBEAR_CLIENT is not set
BR2_PACKAGE_DROPBEAR_DISABLE_REVERSEDNS=y
BR2_PACKAGE_CHRONY=y
```

## configs/elo_qemu_aarch64_gui_defconfig
```kconfig
# Derived from Buildroot 2026.08.1 qemu_aarch64_virt_defconfig.
# External Bootlin toolchain; host QEMU and project launcher; experimental GUI.
BR2_aarch64=y
BR2_TOOLCHAIN_EXTERNAL=y
BR2_TOOLCHAIN_EXTERNAL_BOOTLIN=y
BR2_TOOLCHAIN_EXTERNAL_BOOTLIN_AARCH64_GLIBC_STABLE=y
BR2_GLOBAL_PATCH_DIR="board/qemu/patches"
BR2_DOWNLOAD_FORCE_CHECK_HASHES=y
BR2_SYSTEM_DHCP="eth0"
BR2_LINUX_KERNEL=y
BR2_LINUX_KERNEL_CUSTOM_VERSION=y
BR2_LINUX_KERNEL_CUSTOM_VERSION_VALUE="6.18.7"
BR2_LINUX_KERNEL_USE_CUSTOM_CONFIG=y
BR2_LINUX_KERNEL_CUSTOM_CONFIG_FILE="board/qemu/aarch64-virt/linux.config"
BR2_LINUX_KERNEL_NEEDS_HOST_OPENSSL=y
BR2_TARGET_ROOTFS_EXT2=y
BR2_TARGET_ROOTFS_EXT2_4=y
# BR2_TARGET_ROOTFS_TAR is not set
BR2_TARGET_GENERIC_HOSTNAME="elo-os"
BR2_TARGET_GENERIC_GETTY_PORT="ttyAMA0"
BR2_ROOTFS_OVERLAY="$(BR2_EXTERNAL_ELO_OS_PATH)/board/elo/common/rootfs-overlay $(BR2_EXTERNAL_ELO_OS_PATH)/board/elo/qemu-aarch64-gui/rootfs-overlay $(BR2_EXTERNAL_ELO_OS_PATH)/board/elo/qemu-gui/rootfs-overlay"
BR2_TARGET_ROOTFS_EXT2_SIZE="256M"

# P2 experimental: CPU-rendered Qt Quick, LinuxFB/DRM dumb buffers, no desktop.
BR2_PACKAGE_QT6=y
BR2_PACKAGE_QT6BASE_GUI=y
BR2_PACKAGE_QT6BASE_LINUXFB=y
BR2_PACKAGE_QT6BASE_DEFAULT_QPA="linuxfb"
BR2_PACKAGE_QT6DECLARATIVE=y
BR2_PACKAGE_QT6DECLARATIVE_QUICK=y
BR2_PACKAGE_LIBDRM=y
BR2_PACKAGE_DEJAVU=y
# BR2_PACKAGE_DEJAVU_MONO is not set
# BR2_PACKAGE_DEJAVU_SERIF is not set
# BR2_PACKAGE_DEJAVU_SANS_CONDENSED is not set
# BR2_PACKAGE_DEJAVU_SERIF_CONDENSED is not set
BR2_PACKAGE_ELO_CLIENT=y
```

## package/elo-client/Config.in
```kconfig
config BR2_PACKAGE_ELO_CLIENT
    bool "elo-client (apresentação local Qt Quick; P2)"
    depends on BR2_PACKAGE_QT6BASE_GUI
    depends on BR2_PACKAGE_QT6DECLARATIVE
    depends on BR2_PACKAGE_QT6DECLARATIVE_QUICK
    select BR2_PACKAGE_QT6BASE_PNG
    select BR2_PACKAGE_QT6BASE_JPEG
    select BR2_PACKAGE_QT6BASE_NETWORK
    select BR2_PACKAGE_OPENSSL
    select BR2_PACKAGE_CA_CERTIFICATES
    help
      Núcleo portátil e apresentação local Qt/QML, com observação
      do link local, sem depender de rede para apresentar a fixture.
      Distribuição textual HTTPS opcional com cache local e credencial individual.
      Não implementa a totalidade do domínio ELO.
      Exige configuração apropriada da pilha gráfica DRM/KMS.

config BR2_PACKAGE_ELO_CLIENT_MULTIMEDIA
    bool "elo-client offline audio/video"
    depends on BR2_PACKAGE_ELO_CLIENT
    depends on BR2_PACKAGE_QT6MULTIMEDIA
    depends on BR2_PACKAGE_QT6MULTIMEDIA_FFMPEG
    help
      Enable locally cached WAV/MP3/OGG and MP4/WebM playback.
      Requires a working Qt Multimedia FFmpeg backend and audio output.

config BR2_PACKAGE_ELO_CLIENT_VISION
    bool "elo-client optional local facial perception"
    depends on BR2_PACKAGE_ELO_CLIENT
    depends on BR2_PACKAGE_OPENCV4
    depends on BR2_PACKAGE_OPENCV4_LIB_DNN
    depends on BR2_PACKAGE_OPENCV4_LIB_IMGPROC
    depends on BR2_PACKAGE_OPENCV4_LIB_OBJDETECT
    depends on BR2_PACKAGE_OPENCV4_LIB_VIDEOIO
    help
      Opt-in V4L2 camera presence, orientation and local visit recognition.
      YuNet/SFace model files must be provisioned separately. No downloads.
```
